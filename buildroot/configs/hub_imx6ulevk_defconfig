## buildroot/configs/hub_imx6ulevk_defconfig
```kconfig
# Architecture
BR2_arm=y
BR2_cortex_a7=y

# Toolchain
BR2_GCC_VERSION_5_X=y
BR2_TOOLCHAIN_BUILDROOT_CXX=y
BR2_TOOLCHAIN_BUILDROOT_GLIBC=y
BR2_TOOLCHAIN_BUILDROOT_LIBC="glibc"
BR2_PACKAGE_GLIBC=y
BR2_GLIBC_VERSION_2_23=y
BR2_GLIBC_VERSION_STRING="2.23"

# Linux
BR2_LINUX_KERNEL=y
BR2_LINUX_KERNEL_CUSTOM_GIT=y
BR2_LINUX_KERNEL_CUSTOM_REPO_URL="https://github.com/UVicFormulaMotorsport/hub-linux.git"
BR2_LINUX_KERNEL_CUSTOM_REPO_VERSION="hub-4.1"
BR2_LINUX_KERNEL_DEFCONFIG="imx_v7"
BR2_LINUX_KERNEL_DTS_SUPPORT=y
BR2_LINUX_KERNEL_INTREE_DTS_NAME="imx6ul-14x14-evk"

# U-Boot
BR2_TARGET_UBOOT=y
BR2_TARGET_UBOOT_BUILD_SYSTEM_KCONFIG=y
BR2_TARGET_UBOOT_USE_DEFCONFIG=y
BR2_TARGET_UBOOT_BOARD_DEFCONFIG="hub_imx6ulevk"
BR2_TARGET_UBOOT_CUSTOM_GIT=y
BR2_TARGET_UBOOT_CUSTOM_REPO_URL="https://github.com/UVicFormulaMotorsport/hub-uboot.git"
BR2_TARGET_UBOOT_CUSTOM_REPO_VERSION="hub-2016.09"
BR2_TARGET_UBOOT_FORMAT_IMG=y
BR2_TARGET_UBOOT_SPL=y
BR2_TARGET_UBOOT_SPL_NAME="SPL"

# Root Filesystem
BR2_ROOTFS_POST_IMAGE_SCRIPT="board/hub/imx6ulevk/post-image.sh"
BR2_TARGET_ROOTFS_EXT2=y
BR2_TARGET_ROOTFS_EXT2_4=y

# System
BR2_TARGET_GENERIC_GETTY_PORT="ttymxc0"

# Qt
BR2_PACKAGE_QT=y
BR2_PACKAGE_QT_EMBEDDED=y
BR2_PACKAGE_QT_GFX_LINUXFB=y
BR2_PACKAGE_QT_MOUSE_NO_QWS_CURSOR=y

# Host Packages
BR2_PACKAGE_HOST_LINUX_HEADERS_CUSTOM_4_1=y
BR2_PACKAGE_HOST_DOSFSTOOLS=y
BR2_PACKAGE_HOST_GENIMAGE=y
BR2_PACKAGE_HOST_MTOOLS=y
```
